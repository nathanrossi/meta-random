## conf/machine/raspberrypi-b-mainline.conf
```bitbake
MACHINEOVERRIDES = "raspberrypi:rpi:${MACHINE}"

DEFAULTTUNE ?= "arm1176jzfshf"
require conf/machine/include/tune-arm1176jzf-s.inc

# minimium modules
MACHINE_ESSENTIAL_EXTRA_RRECOMMENDS += " \
        linux-firmware-bcm43430 \
        kernel-module-bcm2835-v4l2 \
        kernel-module-brcmfmac \
        kernel-module-brcmutil \
        kernel-module-lan78xx \
        kernel-module-vc4 \
        kernel-module-vchiq \
        "

# generally useful
MACHINE_EXTRA_RRECOMMENDS += " \
        kernel-modules \
        userland \
        "

PREFERRED_PROVIDER_virtual/kernel = "linux-mainline"

KERNEL_IMAGETYPE = "zImage"
KERNEL_DEVICETREE = " \
        bcm2835-rpi-b.dtb \
        bcm2835-rpi-b-plus.dtb \
        bcm2835-rpi-b-rev2.dtb \
        bcm2835-rpi-zero.dtb \
        bcm2835-rpi-zero-w.dtb \
        "

# Raspberry Pi has no hardware clock
MACHINE_FEATURES_BACKFILL_CONSIDERED = "rtc"
MACHINE_FEATURES += "apm usbhost keyboard vfat ext2 screen touchscreen alsa bluetooth wifi sdio vc4graphics"

# ensure bootfiles are available for wic image building
BOOTFILES_DIR_NAME ?= "bootfiles"
do_image_wic[depends] += "bootfiles:do_deploy"

# rename dtbs to match linux-raspberrypi, so the bootloader can detect automatically
IMAGE_BOOT_FILES ?= " \
        bcm2835-rpi-b.dtb \
        bcm2835-rpi-b-rev2.dtb \
        bcm2835-rpi-b-plus.dtb \
        bcm2835-rpi-zero.dtb \
        bcm2835-rpi-zero-w.dtb \
        ${KERNEL_IMAGETYPE};kernel.img \
        bootfiles/*.bin \
        bootfiles/*.dat \
        bootfiles/*.elf \
        "

# needs at least 128M for h264 camera
GPU_MEM = "256"
VIDEO_CAMERA = "1"

RPI_EXTRA_CONFIG_append = "upstream_kernel=1\n"
```

## conf/machine/raspberrypi0-mainline.conf
```bitbake
MACHINEOVERRIDES = "raspberrypi0:raspberrypi:rpi:${MACHINE}"

require conf/machine/raspberrypi-b-mainline.conf

MACHINE_FEATURES += "usb-gadget"

# usb gadget ethernet
MACHINE_ESSENTIAL_EXTRA_RRECOMMENDS += " \
        kernel-module-g-ether \
        kernel-module-usb-f-eem \
        kernel-module-usb-f-rndis \
        "
```

## conf/machine/raspberrypi3-b-plus.conf
```bitbake
MACHINEOVERRIDES = "raspberrypi3:rpi:${MACHINE}"

#DEFAULTTUNE ?= "cortexa7thf-neon-vfpv4"
#require conf/machine/include/tune-cortexa7.inc
require conf/machine/include/tune-cortexa53.inc

PREFERRED_PROVIDER_virtual/kernel = "linux-mainline"

KERNEL_IMAGETYPE = "Image"
KERNEL_DEVICETREE = "broadcom/bcm2837-rpi-3-b-plus.dtb"
KERNEL_IMAGETYPE:arm = "zImage"
KERNEL_DEVICETREE:arm = "bcm2837-rpi-3-b-plus.dtb"

SERIAL_CONSOLE ?= "115200 ttyS0"

# Raspberry Pi has no hardware clock
MACHINE_FEATURES_BACKFILL_CONSIDERED = "rtc"
MACHINE_FEATURES += "apm usbhost keyboard vfat ext2 screen touchscreen alsa bluetooth wifi sdio vc4graphics"

#MACHINE_ESSENTIAL_EXTRA_RDEPENDS += "rpi-device-tree"

MACHINE_ESSENTIAL_EXTRA_RRECOMMENDS += " \
        linux-firmware-bcm43430 \
        linux-firmware-bcm43455 \
        kernel-module-brcmfmac \
        kernel-module-snd-bcm2835 \
        kernel-module-vc4 \
        kernel-module-vchiq \
        kernel-module-bcm2835-v4l2 \
        kernel-module-sdhci-iproc \
        kernel-module-uio-pdrv-genirq \
        kernel-module-smsc75xx \
        kernel-module-smsc95xx \
        kernel-module-lan78xx \
        "

MACHINE_EXTRA_RRECOMMENDS += " \
        kernel-modules \
        userland \
        "

# ensure bootfiles are available for wic image building
BOOTFILES_DIR_NAME ?= "bootfiles"
do_image_wic[depends] += "bootfiles:do_deploy"

# 32-bit uses kernel7
KERNEL_BOOT_IMAGENAME ??= "kernel8.img"
KERNEL_BOOT_IMAGENAME:arm = "kernel7.img"
IMAGE_BOOT_FILES ?= " \
        bcm2837-rpi-3-b-plus.dtb \
        ${KERNEL_IMAGETYPE};${KERNEL_BOOT_IMAGENAME} \
        bootfiles/*.txt \
        bootfiles/*.bin \
        bootfiles/*.dat \
        bootfiles/*.elf \
        "

#ENABLE_UART ?= "1"
GPU_MEM = "128"
VIDEO_CAMERA = "1"

RPI_EXTRA_CONFIG:append = "upstream_kernel=1\n"
```

## conf/machine/raspberrypi4-mainline.conf
```bitbake
MACHINEOVERRIDES = "raspberrypi4:rpi:${MACHINE}"

DEFAULTTUNE = "cortexa72"
require conf/machine/include/arm/armv8a/tune-cortexa72.inc

PREFERRED_PROVIDER_virtual/kernel = "linux-mainline"

KERNEL_IMAGETYPE = "Image.gz"
# KERNEL_DEVICETREE = "broadcom/bcm2711-rpi-4-b.dtb"
KERNEL_DEVICETREE = "broadcom/bcm2711-rpi-cm4-io.dtb"

SERIAL_CONSOLES ?= "115200;ttyS1"

# Raspberry Pi has no hardware clock
MACHINE_FEATURES_BACKFILL_CONSIDERED = "rtc"
MACHINE_FEATURES += "apm usbhost keyboard vfat ext2 screen alsa bluetooth wifi sdio vc4graphics pci"

#MACHINE_ESSENTIAL_EXTRA_RDEPENDS += "rpi-device-tree"

MACHINE_ESSENTIAL_EXTRA_RRECOMMENDS += " \
        linux-firmware-bcm43455 \
        kernel-module-brcmfmac \
        kernel-module-snd-bcm2835 \
        kernel-module-vc4 \
        kernel-module-vchiq \
        kernel-module-bcm2835-v4l2 \
        kernel-module-sdhci-iproc \
        kernel-module-uio-pdrv-genirq \
        "

MACHINE_EXTRA_RRECOMMENDS += " \
        kernel-modules \
        userland \
        "

# ensure bootfiles are available for wic image building
BOOTFILES_DIR_NAME ?= "bootfiles"
do_image_wic[depends] += "rpi-bootfiles:do_deploy"

KERNEL_BOOT_IMAGENAME ??= "kernel8.img"
IMAGE_BOOT_FILES ?= " \
        bcm2711-rpi-4-b.dtb \
        ${KERNEL_IMAGETYPE};${KERNEL_BOOT_IMAGENAME} \
        bootfiles/*.txt \
        bootfiles/*.bin \
        bootfiles/*.dat \
        bootfiles/*.elf \
        "

ENABLE_UART ?= "1"
GPU_MEM = "128"
VIDEO_CAMERA = "1"

RPI_EXTRA_CONFIG:append = "upstream_kernel=1\n"
```

## conf/machine/sg3100.conf
```bitbake
#@TYPE: Machine
#@NAME: Netgate SG3100
#@DESCRIPTION: Machine configuration for Netgate SG3100

require conf/machine/include/arm/armv7a/tune-cortexa9.inc

MACHINE_FEATURES += "usbhost vfat ext2 ext3 ext4 pci serial rtc"

SERIAL_CONSOLES ?= "115200;ttyS0"

PREFERRED_PROVIDER_virtual/kernel ?= "linux-mainline"
KERNEL_IMAGETYPES = "zImage"
KERNEL_EXTRA_ARGS += "LOADADDR=${UBOOT_ENTRYPOINT}"
MACHINE_EXTRA_RRECOMMENDS = "kernel-modules"

# KERNEL_DEVICETREE = "armada-380-sg3100.dtb"
MACHINE_ESSENTIAL_EXTRA_RDEPENDS += "sg3100-devicetree"

UBOOT_ENTRYPOINT = "0x1000000"
UBOOT_LOADADDRESS = "0x1000000"

IMAGE_FSTYPES:append = " cpio cpio.gz cpio.zst"
```

## conf/machine/toolbox-x64.conf
```bitbake
#@TYPE: Machine
#@NAME: toolbox generigc x64.
#@DESCRIPTION: Target multiple common use x64 hosts for headless toolbox

DEFAULTTUNE ?= "core2-64"
require conf/machine/include/tune-core2.inc

MACHINE_FEATURES += " \
	efi acpi \
	screen keyboard pci usbhost usbgadget serial alsa \
	vfat ext2 ext3 x86 \
	wifi \
	"

# default to initramfs
INITRAMFS_IMAGE = "core-image-toolbox"
INITRAMFS_IMAGE_BUNDLE = "1"

KERNEL_IMAGETYPE ?= "bzImage"
PREFERRED_PROVIDER_virtual/kernel ?= "linux-mainline"

MACHINE_EXTRA_RRECOMMENDS += "kernel-modules linux-firmware"

SERIAL_CONSOLES ?= "115200;ttyS0"
SERIAL_CONSOLES_CHECK = "ttyS0"

# the kernel provides efi boot image, as efi stub
EFI_PROVIDER = ""

# put kernel stubed efi image into a directory that works for removable disks
IMAGE_BOOT_FILES ?= " \
		${KERNEL_IMAGETYPE};EFI/boot/bootx64.efi \
		"
```

## files/wic/vfat-bootonly.wks
```
part /boot --source bootimg-partition --fstype=vfat --label boot --active --align 4096 --size 16
```

## meta-libc/conf/layer.conf
```bitbake
# We have a conf and classes directory, add to BBPATH
BBPATH .= ":${LAYERDIR}"
# We have recipes-* directories, add to BBFILES
BBFILES += "${LAYERDIR}/recipes-*/*/*.bb"

BBFILE_COLLECTIONS += "libc"
BBFILE_PATTERN_libc = "^${LAYERDIR}/"
BBFILE_PRIORITY_libc = "6"
```

## meta-remotebox/conf/distro/remotebox.conf
```bitbake
DISTRO = "remotebox"
DISTRO_NAME = "RemoteBox Machione"
DISTRO_VERSION = "1.0"
DISTRO_CODENAME = "nyx"

TARGET_VENDOR = "-rbox"

DISTRO_FEATURES ?= " \
		${DISTRO_FEATURES_DEFAULT} \
		${DISTRO_FEATURES_LIBC} \
		largefile multiarch \
		"

PREFERRED_VERSION_linux-yocto ?= "4.1%"

DISTRO_EXTRA_RDEPENDS += " packagegroup-core-boot"
DISTRO_EXTRA_RRECOMMENDS += " kernel-module-af-packet"

# add poky sanity bbclass
INHERIT += "poky-sanity"

# QA check settings - a little stricter than the OE-Core defaults
WARN_TO_ERROR_QA = " \
		already-stripped compile-host-path install-host-path \
		installed-vs-shipped ldflags pn-overrides rpaths staticdev \
		useless-rpaths \
		"
WARN_QA_remove = "${WARN_TO_ERROR_QA}"
ERROR_QA_append = " ${WARN_TO_ERROR_QA}"

DISTRO_FEATURES_append = " systemd"
VIRTUAL-RUNTIME_init_manager = "systemd"
DISTRO_FEATURES_BACKFILL_CONSIDERED = "sysvinit"
VIRTUAL-RUNTIME_initscripts = ""

PACKAGECONFIG_append_pn-systemd = " networkd resolved"
SYSTEMD_AUTO_ENABLE_pn-wpa-supplicant = "enable"

# force use of coreutils instead of busybox
ALTERNATIVE_PRIORITY_pn-coreutils = "90"

KERNEL_FEATURES += "features/iwlwifi/iwlwifi.scc"
```

## meta-remotebox/conf/layer.conf
```bitbake
# We have a conf and classes directory, add to BBPATH
BBPATH .= ":${LAYERDIR}"
# We have recipes-* directories, add to BBFILES
BBFILES += "${LAYERDIR}/recipes-*/*.bb"
BBFILES += "${LAYERDIR}/recipes-*/*/*.bb"
BBFILES += "${LAYERDIR}/recipes-*/*.bbappend"
BBFILES += "${LAYERDIR}/recipes-*/*/*.bbappend"

BBFILE_COLLECTIONS += "remotebox"
BBFILE_PATTERN_remotebox = "^${LAYERDIR}/"
BBFILE_PRIORITY_remotebox = "6"
```

## meta-remotebox/scripts/lib/wic/canned-wks/initramfs-pcbios.wks
```
part /boot --source bootimg-initramfs-pcbios --ondisk sda --label msdos --active --align 1024
bootloader --timeout=0 --append="console=tty0"
```

## meta-testfloatabi/conf/layer.conf
```bitbake
# We have a conf and classes directory, add to BBPATH
BBPATH .= ":${LAYERDIR}"
# We have recipes-* directories, add to BBFILES
BBFILES += "${LAYERDIR}/recipes-*/*/*.bb"

BBFILE_COLLECTIONS += "testfloatabi"
BBFILE_PATTERN_testfloatabi = "^${LAYERDIR}/"
BBFILE_PRIORITY_testfloatabi = "6"
```

## meta-toolchain-test/conf/layer.conf
```bitbake
# We have a conf and classes directory, add to BBPATH
BBPATH .= ":${LAYERDIR}"
# We have recipes-* directories, add to BBFILES
BBFILES += "${LAYERDIR}/recipes-*/*/*.bb"

BBFILE_COLLECTIONS += "toolchain-test"
BBFILE_PATTERN_toolchain-test = "^${LAYERDIR}/"
BBFILE_PRIORITY_toolchain-test = "6"
```

## meta-zedboard-bsp/conf/layer.conf
```bitbake
# We have a conf and classes directory, add to BBPATH
BBPATH := "${BBPATH}:${LAYERDIR}"

#BBFILES += "${LAYERDIR}/recipes-*/*/*.bb"
#BBFILES += "${LAYERDIR}/recipes-*/*/*.bbappend"

BBFILE_COLLECTIONS += "zedboard-bsp"
BBFILE_PATTERN_zedboard-bsp := "^${LAYERDIR}/"
BBFILE_PRIORITY_zedboard-bsp = "8"

LAYERDEPENDS_zedboard-bsp = "core xilinx"
```

## meta-zedboard-bsp/conf/machine/zedboard-adi-zynq7.conf
```bitbake
#@TYPE: Machine
#@NAME: zedboard-adi-zynq7
#@DESCRIPTION: Machine support for ZedBoard. (http://www.zedboard.org/)

require conf/machine/include/tune-zynq.inc
require conf/machine/include/machine-xilinx-default.inc
require conf/machine/include/machine-xilinx-board.inc

# Zedboard machine definition known by Xilinx UBOOT
UBOOT_MACHINE = "zynq_zed_config"

SERIAL_CONSOLE = "115200 ttyPS0"

MACHINE_DEVICETREE := " \
		common/zynq7-base.dtsi \
		zedboard/zedboard-zynq7-board.dtsi \
		zedboard/zedboard-adi-zynq7-board.dtsi \
		zedboard/zedboard-adi-zynq7.dts \
		"

KERNEL_FEATURES += "zedboard-adi.scc drm-adi-hdmi.scc adi-sound.scc input.scc"

EXTRA_IMAGEDEPENDS += "virtual/bitstream"

PREFERRED_PROVIDER_virtual/kernel = "linux-adi"
PREFERRED_VERSION_linux-adi = "3.15%"
```

## wic/sdimage-bootonly.wks
```
part /boot --source bootimg-partition --ondisk mmcblk --fstype=vfat --label boot --active --align 4096 --size 16
```
