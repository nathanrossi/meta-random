## conf/distro/multitool.conf
```bitbake
DISTRO = "multitool"
DISTRO_NAME = "Raspberry PI USB Multitool"
DISTRO_VERSION = "1.0"
DISTRO_CODENAME = ""

# musl by default
TCLIBC = "musl"

# disable some features
DISTRO_FEATURES:remove = " x11 alsa zeroconf 3g nfc pcmcia irda bluetooth nfs ipv6"

# custom simpler init setup
VIRTUAL-RUNTIME_init_manager = "rust-simple-init"
VIRTUAL-RUNTIME_dev_manager = "busybox-mdev"

# no sysvinit or initscripts
VIRTUAL-RUNTIME_initscripts = ""
DISTRO_FEATURES_BACKFILL_CONSIDERED = "sysvinit"

EXTRA_IMAGE_FEATURES = "debug-tweaks"
EXTRA_IMAGE_FEATURES += "ssh-server-openssh"

# cut out some packages that are useless on a initramfs
IMAGE_FEATURES:append:pn-core-image-minimal = " read-only-rootfs"

# ensure the image is built with cpio.gz
IMAGE_FSTYPES:append:pn-core-image-minimal = " cpio cpio.gz"

CORE_IMAGE_EXTRA_INSTALL += "packagegroup-utility-tools"

# Generate SSH keys at build time
CORE_IMAGE_EXTRA_INSTALL += "openssh-pregenerate"
```

## conf/distro/printer.conf
```bitbake
DISTRO = "printer"
DISTRO_NAME = "Printer"
DISTRO_VERSION = "1.0"
DISTRO_CODENAME = "zeus"

# musl by default
TCLIBC = "musl"

# disable some features
DISTRO_FEATURES:remove = " x11 alsa zeroconf 3g nfc pcmcia irda bluetooth nfs ipv6"
DISTRO_FEATURES:append = " opengl vulkan"

# custom simpler init setup
VIRTUAL-RUNTIME_init_manager = "rust-simple-init"
VIRTUAL-RUNTIME_dev_manager = "busybox-mdev"

# no sysvinit or initscripts
VIRTUAL-RUNTIME_initscripts = ""
DISTRO_FEATURES_BACKFILL_CONSIDERED = "sysvinit"

# systemd
#DISTRO_FEATURES:append = " systemd"
#VIRTUAL-RUNTIME_init_manager = "systemd"
# systemd-networkd networking/routing
#PACKAGECONFIG:append:pn-systemd = " networkd resolved iptc"
#CORE_IMAGE_EXTRA_INSTALL += "networkd-config"

EXTRA_IMAGE_FEATURES = "debug-tweaks"
EXTRA_IMAGE_FEATURES += "ssh-server-openssh"

# ffmpeg
LICENSE_FLAGS_ACCEPTED:pn-ffmpeg = "commercial"
LICENSE_FLAGS_ACCEPTED:pn-x264 = "commercial"

# cut out some packages that are useless on a initramfs
IMAGE_FEATURES:append:pn-core-image-minimal = " read-only-rootfs"

# ensure the image is built with cpio.gz
IMAGE_FSTYPES:append:pn-core-image-minimal = " cpio cpio.gz"

#CORE_IMAGE_EXTRA_INSTALL += "packagegroup-3dprinter"
CORE_IMAGE_EXTRA_INSTALL += "packagegroup-utility-tools"

# Generate SSH keys at build time
CORE_IMAGE_EXTRA_INSTALL += "openssh-pregenerate"
```

## conf/distro/remotebox.conf
```bitbake
DISTRO = "remotebox"
DISTRO_NAME = "remotebox"
DISTRO_VERSION = "1.0"
DISTRO_CODENAME = "none"

TCLIBC = "glibc"

require conf/distro/include/no-static-libs.inc
require conf/distro/include/security_flags.inc

hostname:remotebox = "remotebox"

# disable some features
DISTRO_FEATURES:remove = " x11 alsa zeroconf 3g nfc pcmcia irda bluetooth nfs opengl vulkan "
DISTRO_FEATURES:append = " largefile "
# use pam for proper login/session management via systemd
DISTRO_FEATURES:append = " pam "

# no sysvinit or initscripts
VIRTUAL-RUNTIME_initscripts = ""
DISTRO_FEATURES_BACKFILL_CONSIDERED = "sysvinit"

# systemd
DISTRO_FEATURES:append = " systemd "
VIRTUAL-RUNTIME_init_manager = "systemd"
# systemd-networkd networking/routing
PACKAGECONFIG:append:pn-systemd = " networkd resolved iptc "
# resolved dns-over-tls, default DoT
PACKAGECONFIG:append:pn-systemd = " openssl "
EXTRA_OEMESON:append:pn-systemd = " -Ddefault-dns-over-tls=yes "

# configure packages
PACKAGECONFIG:append:pn-iptables = " libnfnetlink "
# disable default network configuration
PACKAGECONFIG:pn-systemd-conf = ""

# prevent all debug-tweaks
EXTRA_IMAGE_FEATURES:remove = "debug-tweaks"
IMAGE_FEATURES:append = " empty-root-password "
# cut out some packages that are useless on a initramfs
IMAGE_FEATURES:append = " read-only-rootfs "

# ensure the image is built with cpio.gz
IMAGE_FSTYPES:append = " cpio cpio.gz cpio.zst "

CORE_IMAGE_EXTRA_INSTALL += "remotebox-config"

CORE_IMAGE_EXTRA_INSTALL += "openssh"
CORE_IMAGE_EXTRA_INSTALL += "openssh-sftp"
CORE_IMAGE_EXTRA_INSTALL += "openssh-sftp-server"
# Generate SSH keys at build time
CORE_IMAGE_EXTRA_INSTALL += "openssh-pregenerate"

# base
# CORE_IMAGE_EXTRA_INSTALL += "kernel-modules"
CORE_IMAGE_EXTRA_INSTALL += "kernel-module-uvcvideo"
CORE_IMAGE_EXTRA_INSTALL += "systemd-analyze"
CORE_IMAGE_EXTRA_INSTALL += "tzdata"
# systemd with busybox less is annoying
CORE_IMAGE_EXTRA_INSTALL += "less"

# dev
CORE_IMAGE_EXTRA_INSTALL += "ncurses-terminfo"
CORE_IMAGE_EXTRA_INSTALL += "vim"
CORE_IMAGE_EXTRA_INSTALL += "git"
CORE_IMAGE_EXTRA_INSTALL += "coreutils"
CORE_IMAGE_EXTRA_INSTALL += "findutils"
CORE_IMAGE_EXTRA_INSTALL += "grep"
CORE_IMAGE_EXTRA_INSTALL += "file"
CORE_IMAGE_EXTRA_INSTALL += "fish-shell"

# compiler dev
CORE_IMAGE_EXTRA_INSTALL += "binutils binutils-symlinks"
CORE_IMAGE_EXTRA_INSTALL += "cpp cpp-symlinks"
CORE_IMAGE_EXTRA_INSTALL += "gcc gcc-symlinks"
CORE_IMAGE_EXTRA_INSTALL += "g++ g++-symlinks"
CORE_IMAGE_EXTRA_INSTALL += "libstdc++ libstdc++-dev"
CORE_IMAGE_EXTRA_INSTALL += "make"

# devices/network
CORE_IMAGE_EXTRA_INSTALL += "usbutils ethtool"
CORE_IMAGE_EXTRA_INSTALL += "pciutils"
CORE_IMAGE_EXTRA_INSTALL += "util-linux"
CORE_IMAGE_EXTRA_INSTALL += "procps"
CORE_IMAGE_EXTRA_INSTALL += "iproute2 iproute2-tc"
CORE_IMAGE_EXTRA_INSTALL += "iptables nftables"
CORE_IMAGE_EXTRA_INSTALL += "iputils-ping"
CORE_IMAGE_EXTRA_INSTALL += "inetutils-traceroute"
CORE_IMAGE_EXTRA_INSTALL += "net-tools"
CORE_IMAGE_EXTRA_INSTALL += "iperf2"
CORE_IMAGE_EXTRA_INSTALL += "iperf3"
CORE_IMAGE_EXTRA_INSTALL += "tcpdump"
CORE_IMAGE_EXTRA_INSTALL += "bind-utils"
CORE_IMAGE_EXTRA_INSTALL += "rsync"

# disk/filesystem
CORE_IMAGE_EXTRA_INSTALL += "e2fsprogs"
CORE_IMAGE_EXTRA_INSTALL += "btrfs-tools"
CORE_IMAGE_EXTRA_INSTALL += "dosfstools"
CORE_IMAGE_EXTRA_INSTALL += "exfat-utils"
CORE_IMAGE_EXTRA_INSTALL += "hdparm"

# application
CORE_IMAGE_EXTRA_INSTALL += "python3"
LICENSE_FLAGS_ACCEPTED += "commercial"
CORE_IMAGE_EXTRA_INSTALL += "ffmpeg"
CORE_IMAGE_EXTRA_INSTALL += "v4l-utils"
CORE_IMAGE_EXTRA_INSTALL += "mjpg-streamer"
```

## conf/distro/testbox.conf
```bitbake
DISTRO = "testbox"
DISTRO_NAME = "testbox"
DISTRO_VERSION = "1.0"
DISTRO_CODENAME = "none"

TCLIBC = "glibc"

require conf/distro/include/no-static-libs.inc
require conf/distro/include/security_flags.inc

INHERIT += "image-buildinfo"
IMAGE_BUILDINFO_VARS += " LAYERSERIES_CORENAMES"

GLIBC_GENERATE_LOCALES = "en_US.UTF-8"
IMAGE_LINGUAS ?= "en-us"

# No hostname
hostname:testbox = "testbox"

# disable some features
DISTRO_FEATURES:remove = " x11 alsa zeroconf 3g nfc pcmcia irda bluetooth nfs vulkan "
DISTRO_FEATURES:append = " largefile usrmerge pam opengl "

# prevent kernel image from being embedded in rootfs
RRECOMMENDS:${KERNEL_PACKAGE_NAME}-base = ""

# no sysvinit or initscripts
VIRTUAL-RUNTIME_initscripts = ""
DISTRO_FEATURES_BACKFILL_CONSIDERED = "sysvinit"

# systemd
DISTRO_FEATURES:append = " systemd "
VIRTUAL-RUNTIME_init_manager = "systemd"
# systemd-networkd networking/routing
PACKAGECONFIG:append:pn-systemd = " networkd resolved iptc "
# resolved dns-over-tls, default DoT
PACKAGECONFIG:append:pn-systemd = " openssl "
EXTRA_OEMESON:append:pn-systemd = " -Ddefault-dns-over-tls=yes "
CORE_IMAGE_EXTRA_INSTALL += "systemd-analyze"
# systemd with busybox less is annoying
CORE_IMAGE_EXTRA_INSTALL += "less"

# prevent all debug-tweaks
EXTRA_IMAGE_FEATURES:remove = "debug-tweaks"
IMAGE_FEATURES:append = " empty-root-password "
# cut out some packages that are useless on a initramfs
IMAGE_FEATURES:append = " read-only-rootfs "

# ensure the image is built with cpio.gz
IMAGE_FSTYPES = " cpio cpio.gz cpio.zst "
IMAGE_NAME_SUFFIX ?= ""
INITRAMFS_IMAGE = "core-image-minimal"
INITRAMFS_IMAGE_BUNDLE = "1"

CORE_IMAGE_EXTRA_INSTALL += "openssh"
CORE_IMAGE_EXTRA_INSTALL += "openssh-sftp"
CORE_IMAGE_EXTRA_INSTALL += "openssh-sftp-server"
# Generate SSH keys at build time
CORE_IMAGE_EXTRA_INSTALL += "openssh-pregenerate"
CORE_IMAGE_EXTRA_INSTALL += "openssh-developer-keys"

# base
CORE_IMAGE_EXTRA_INSTALL += "kernel-modules"
CORE_IMAGE_EXTRA_INSTALL += "kexec-tools"
CORE_IMAGE_EXTRA_INSTALL += "tzdata"

# dev
CORE_IMAGE_EXTRA_INSTALL += "ncurses-terminfo"
CORE_IMAGE_EXTRA_INSTALL += "vim"
CORE_IMAGE_EXTRA_INSTALL += "python3 python3-modules"
CORE_IMAGE_EXTRA_INSTALL += "git"
CORE_IMAGE_EXTRA_INSTALL += "coreutils"
CORE_IMAGE_EXTRA_INSTALL += "findutils"
CORE_IMAGE_EXTRA_INSTALL += "grep"
CORE_IMAGE_EXTRA_INSTALL += "file"
CORE_IMAGE_EXTRA_INSTALL += "tmux locale-base-en-us"

# build/compiler
CORE_IMAGE_EXTRA_INSTALL += "binutils binutils-symlinks"
CORE_IMAGE_EXTRA_INSTALL += "cpp cpp-symlinks"
CORE_IMAGE_EXTRA_INSTALL += "gcc gcc-symlinks"
CORE_IMAGE_EXTRA_INSTALL += "g++ g++-symlinks"
CORE_IMAGE_EXTRA_INSTALL += "libstdc++ libstdc++-dev"
CORE_IMAGE_EXTRA_INSTALL += "make"

# CPU/system
CORE_IMAGE_EXTRA_INSTALL += "turbostat"
CORE_IMAGE_EXTRA_INSTALL += "stress-ng"

# devices/network
PACKAGECONFIG:pn-lmsensors-config = ""
PACKAGECONFIG:pn-lmsensors = ""
CORE_IMAGE_EXTRA_INSTALL += "memtester"
CORE_IMAGE_EXTRA_INSTALL += "lmsensors"
CORE_IMAGE_EXTRA_INSTALL += "dmidecode"
CORE_IMAGE_EXTRA_INSTALL += "usbutils"
CORE_IMAGE_EXTRA_INSTALL += "pciutils"
CORE_IMAGE_EXTRA_INSTALL += "lsscsi"
CORE_IMAGE_EXTRA_INSTALL += "util-linux"
CORE_IMAGE_EXTRA_INSTALL += "procps"
CORE_IMAGE_EXTRA_INSTALL += "ethtool"
CORE_IMAGE_EXTRA_INSTALL += "iproute2 iproute2-tc"
CORE_IMAGE_EXTRA_INSTALL += "iptables nftables"
CORE_IMAGE_EXTRA_INSTALL += "iputils-ping"
CORE_IMAGE_EXTRA_INSTALL += "inetutils-traceroute"
CORE_IMAGE_EXTRA_INSTALL += "net-tools"
CORE_IMAGE_EXTRA_INSTALL += "iperf2"
CORE_IMAGE_EXTRA_INSTALL += "iperf3"
CORE_IMAGE_EXTRA_INSTALL += "tcpdump"
CORE_IMAGE_EXTRA_INSTALL += "bind-utils"
CORE_IMAGE_EXTRA_INSTALL += "rsync"

# disk/filesystem
CORE_IMAGE_EXTRA_INSTALL += "fio"
CORE_IMAGE_EXTRA_INSTALL += "e2fsprogs"
CORE_IMAGE_EXTRA_INSTALL += "btrfs-tools"
CORE_IMAGE_EXTRA_INSTALL += "dosfstools"
CORE_IMAGE_EXTRA_INSTALL += "exfatprogs"
CORE_IMAGE_EXTRA_INSTALL += "hdparm"
CORE_IMAGE_EXTRA_INSTALL += "flashrom"

# hw debug
CORE_IMAGE_EXTRA_INSTALL += "devmem2"

# display/graphics
CORE_IMAGE_EXTRA_INSTALL += "kernel-module-i915"
CORE_IMAGE_EXTRA_INSTALL += "linux-firmware-i915"
CORE_IMAGE_EXTRA_INSTALL += "kmscube"
```

## conf/distro/tiny.conf
```bitbake
DISTRO = "tiny"
DISTRO_NAME = "tiny"
DISTRO_VERSION = "1.0"
DISTRO_CODENAME = "none"

TCLIBC = "musl"
# TCLIBC = "glibc"

require conf/distro/include/no-static-libs.inc
require conf/distro/include/security_flags.inc

EFI_PROVIDER = ""

# No hostname
hostname:tiny = ""

# disable some features
DISTRO_FEATURES:remove = " x11 alsa zeroconf 3g nfc pcmcia irda bluetooth nfs opengl vulkan "
DISTRO_FEATURES:append = " sysvinit largefile usrmerge "

VIRTUAL-RUNTIME_dev_manager = "busybox-mdev"

# prevent kernel image from being embedded in rootfs
RRECOMMENDS:${KERNEL_PACKAGE_NAME}-base = ""
PREFERRED_PROVIDER_virtual/kernel = "linux-yocto-tiny"
# PREFERRED_PROVIDER_virtual/kernel = "linux-mainline"

# prevent all debug-tweaks
EXTRA_IMAGE_FEATURES:remove = "debug-tweaks"
IMAGE_FEATURES:append = " empty-root-password "
# cut out some packages that are useless on a initramfs
IMAGE_FEATURES:append = " read-only-rootfs "

# ensure the image is built with cpio.gz
IMAGE_FSTYPES:tiny = " tar.gz cpio cpio.gz "

# kexec
CORE_IMAGE_EXTRA_INSTALL += "kexec-tools"

# devices/network
CORE_IMAGE_EXTRA_INSTALL += "pciutils"
```

## conf/distro/toolbox.conf
```bitbake
DISTRO = "toolbox"
DISTRO_NAME = "ToolBox"
DISTRO_VERSION = "1.0"
DISTRO_CODENAME = "zeus"
TARGET_VENDOR = "-toolbox"

# musl by default
#TCLIBC ?= "musl"
# for now, need glibc for systemd-resolved

# disable some features
DISTRO_FEATURES:remove = " x11 alsa zeroconf 3g nfc pcmcia irda bluetooth nfs ipv6"

# systemd only
DISTRO_FEATURES:append = " systemd"
VIRTUAL-RUNTIME:init_manager = "systemd"
VIRTUAL-RUNTIME:initscripts = ""
DISTRO_FEATURES_BACKFILL_CONSIDERED = "sysvinit"

# systemd-networkd networking/routing
PACKAGECONFIG:append:pn-systemd = " networkd resolved iptc"
# wpa
SYSTEMD_AUTO_ENABLE:pn-wpa-supplicant = "enable"

# kernel features
#KERNEL_FEATURES += "features/iwlwifi/iwlwifi.scc"
#KERNEL_FEATURES += "features/wifi/wifi-usb.scc"
#KERNEL_FEATURES += "features/usb/serial.scc"
#KERNEL_FEATURES += "features/usb/serial-all.scc"
#KERNEL_FEATURES += "features/usb-net/usb-net.scc"

EXTRA_IMAGE_FEATURES = "debug-tweaks"
EXTRA_IMAGE_FEATURES += "ssh-server-openssh"

# prefer newest version of linux-yocto
PREFERRED_VERSION:linux-yocto ?= "4.15%"
# prefer mainline for now
PREFERRED_PROVIDER:virtual/kernel = "linux-mainline"
```

## conf/layer.conf
```bitbake
# We have a conf and classes directory, add to BBPATH
BBPATH .= ":${LAYERDIR}"

BBFILES += "${LAYERDIR}/recipes-tests/*/*.bb"
BBFILES += "${LAYERDIR}/recipes-tests/*/*.bbappend"
BBFILES += "${LAYERDIR}/recipes-utility/*/*.bb"
BBFILES += "${LAYERDIR}/recipes-utility/*/*.bbappend"
BBFILES += "${LAYERDIR}/recipes-bsp/*/*.bb"
BBFILES += "${LAYERDIR}/recipes-bsp/*/*.bbappend"
BBFILES += "${LAYERDIR}/recipes-kernel/*/*.bb"
BBFILES += "${LAYERDIR}/recipes-kernel/*/*.bbappend"

BBFILE_COLLECTIONS += "random"
BBFILE_PATTERN_random = "^${LAYERDIR}/"
BBFILE_PRIORITY_random = "6"

# raspberrypi specific bbappends
BBFILES_DYNAMIC += "raspberrypi:${LAYERDIR}/recipes-raspberrypi/*/*.bb"

LAYERDEPENDS_random = "core networking-layer"
LAYERSERIES_COMPAT_random = "hardknott honister kirkstone langdale mickledore nanbield scarthgap"

include conf/buildvars-additional.conf
```

## conf/machine/ox64.conf
```bitbake
#@TYPE: Machine
#@NAME: ox64
#@DESCRIPTION: Ox64

require conf/multilib.conf
NON_MULTILIB_RECIPES:remove = "u-boot"
MULTILIBS = "multilib:lib32"

DEFAULTTUNE ?= "riscv64"
DEFAULTTUNE:virtclass-multilib-lib32 = "riscv32"

require conf/machine/include/riscv/tune-riscv.inc

# SERIAL_CONSOLES ?= "115200;ttyLXU0"

RISCV_SBI_PLAT ?= "generic"

EXTRA_IMAGEDEPENDS += "opensbi-bl808 u-boot-bl808 lib32-u-boot-bl808"

UBOOT_CONFIG = "d0"
UBOOT_CONFIG:virtclass-multilib-lib32 = "m0"
UBOOT_CONFIG[d0] = "bl808_d0_defconfig"
UBOOT_CONFIG[m0] = "bl808_m0_defconfig"

PREFERRED_PROVIDER:virtual/kernel = "linux-bl808"
KERNEL_IMAGETYPE = "Image"
KERNEL_DEVICETREE = "bouffalolab/bl808-pine64-ox64.dtb"

IMAGE_FSTYPES += "cpio cpio.gz"
```

## conf/machine/print-net-camera.conf
```bitbake
MACHINEOVERRIDES = "raspberrypi:rpi:${MACHINE}"

DEFAULTTUNE ?= "arm1176jzfshf"
require conf/machine/include/tune-arm1176jzf-s.inc

MACHINE_EXTRA_RRECOMMENDS += " \
        linux-firmware-bcm43430 \
        kernel-module-bcm2835-v4l2 \
        kernel-module-brcmfmac \
        kernel-module-brcmutil \
        kernel-module-lan78xx \
        kernel-module-vc4 \
        kernel-module-vchiq \
        kernel-modules \
        userland \
        "

KERNEL_IMAGETYPE = "zImage"
KERNEL_DEVICETREE = " \
        bcm2835-rpi-b.dtb \
        bcm2835-rpi-b-plus.dtb \
        bcm2835-rpi-b-rev2.dtb \
        bcm2835-rpi-zero.dtb \
        bcm2835-rpi-zero-w.dtb \
        "

# Raspberry Pi has no hardware clock
MACHINE_FEATURES_BACKFILL_CONSIDERED = "rtc"
MACHINE_FEATURES += "apm usbhost keyboard vfat ext2 screen touchscreen alsa bluetooth wifi sdio vc4graphics"

IMAGE_BOOT_FILES ?= " \
        bcm2835-rpi-b-rev2.dtb \
        ${KERNEL_IMAGETYPE};kernel.img \
        bcm2835-bootfiles/*.txt \
        bcm2835-bootfiles/*.bin \
        bcm2835-bootfiles/*.dat \
        bcm2835-bootfiles/*.elf \
        "

# ensure bootfiles are available for wic image building
do_image_wic[depends] += "bcm2835-bootfiles:do_deploy"
# ensure the image is built with cpio.gz
IMAGE_FSTYPES_append_pn-core-image-minimal = " cpio cpio.gz"
IMAGE_BOOT_FILES_append_pn-disk-image-minimal = " \
        core-image-minimal-${MACHINE}.cpio.gz;initramfs.gz \
        "

# needs at least 128M for h264 camera
GPU_MEM = "128"
VIDEO_CAMERA = "1"

# something broke followkernel, so point it at 0x08000000 aka @128M
RPI_EXTRA_CONFIG = '\ndevice_tree=bcm2835-rpi-b-rev2.dtb\ninitramfs initramfs.gz 0x08000000\n'
```
